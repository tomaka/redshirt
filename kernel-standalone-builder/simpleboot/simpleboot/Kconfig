## kernel-standalone-builder/simpleboot/simpleboot/Kconfig
```kconfig
if PAYLOAD_SIMPLEBOOT

config PAYLOAD_FILE
	default "payloads/external/simpleboot/src/loader_cb.elf"

endif
```

## kernel-standalone-builder/simpleboot/simpleboot/Kconfig.name
```kconfig
config PAYLOAD_SIMPLEBOOT
	bool "Simpleboot"
	depends on ARCH_X86 || ARCH_ARM64
	select WANT_LINEAR_FRAMEBUFFER
	select COMPRESSED_PAYLOAD_NONE
	select DEFAULT_CONSOLE_LOGLEVEL_3
	help
	  Select this option if you want to build a coreboot image
	  with Simpleboot (simplified Multiboot2 Protocol) payload.

	  See https://gitlab.com/bztsrc/simpleboot for more information.
```
